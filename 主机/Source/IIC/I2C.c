/*******************************************************************************************************
**------------------------------------------------------------------------------------------------------
** 文件: I2C 
** 版本: v1.0
**------------------------------------------------------------------------------------------------------
** 描述:
**      I2C驱动函数
**------------------------------------------------------------------------------------------------------
********************************************************************************************************/
#include "config.h"
#include "I2c.h"


#define SDA  PBout(7)
#define rSDA  PBin(7)
#define SCL  PBout(6)

/*******************************************************************************************************
** 函数: DelayAt24c02, SPI延时函数
**------------------------------------------------------------------------------------------------------
** 参数:  ms 时间 
** 返回: void
*******************************************************************************************************/
static void DelayAt24c02(unsigned long ms)
{	
	while(ms--);
}
/*******************************************************************************************************
** 函数: AtGpioInit, 初始化
**------------------------------------------------------------------------------------------------------
** 参数: void 
** 返回: void
*******************************************************************************************************/
void I2cGpioInit(void)
{
 	GPIO_InitTypeDef GPIO_InitStructure;	
	//------------------------------------------------------------------------------------------------
	// 配置IO和时钟
	RCC_APB2PeriphClockCmd(RCC_APB2Periph_GPIOB  , ENABLE);	
	GPIO_InitStructure.GPIO_Pin   = GPIO_Pin_6 ;				//SCLK时钟
	GPIO_InitStructure.GPIO_Mode  = GPIO_Mode_Out_OD;					
	GPIO_InitStructure.GPIO_Speed = GPIO_Speed_50MHz;
	GPIO_Init(GPIOB, &GPIO_InitStructure);
	GPIO_ResetBits(GPIOB,GPIO_Pin_6);						
	GPIO_InitStructure.GPIO_Pin   = GPIO_Pin_7;					//MOSI主出从入
	GPIO_InitStructure.GPIO_Mode  = GPIO_Mode_Out_OD;					
	GPIO_InitStructure.GPIO_Speed = GPIO_Speed_50MHz;
	GPIO_Init(GPIOB, &GPIO_InitStructure);
	GPIO_ResetBits(GPIOB,GPIO_Pin_7);			   
}




/*******************************************************************************************************
** 函数: I2cStart,I2C开始信号
**------------------------------------------------------------------------------------------------------
** 参数: void
** 返回: void
********************************************************************************************************/
void I2cStart(void)
{	
	SDA=1; 
	SCL=1; 
	DelayAt24c02(1);
	SDA=0; 
	SCL=0;

}
 
/*******************************************************************************************************
** 函数: I2cStop,I2C停止信号
**------------------------------------------------------------------------------------------------------
** 参数: void
** 返回: void
********************************************************************************************************/
void I2cStop( void )
{	
	SDA=0; 
	SCL=0; 
	DelayAt24c02(1);
	SCL=1; 
	SDA=1;
	DelayAt24c02(0xffff);
}

/*******************************************************************************************************
** 函数: I2cACK,应答读信号
**------------------------------------------------------------------------------------------------------
** 参数: void
** 返回: void
********************************************************************************************************/
void I2cACK(void)
{	
	SCL=0;
	SDA=0; 
	SCL=1; 
	DelayAt24c02(1);
	SCL=0;
	SDA=1; 
}

/*******************************************************************************************************
** 函数: I2cNoACK,非应答信号
**------------------------------------------------------------------------------------------------------
** 参数: void
** 返回: void
********************************************************************************************************/
void I2cNoACK(void)
{	
	SCL=0; 
	SDA=1; 
	SCL=1; 
	DelayAt24c02(1);
	SCL=0; 
}

/*******************************************************************************************************
** 函数: I2cRACK,读取应答信号
**------------------------------------------------------------------------------------------------------
** 参数: void
** 返回: 有应答=1,无应答=0
********************************************************************************************************/
int I2cRACK(void) 	 
{
	int bat=0;
	SCL=0; 
	SDA=1;			
	SCL=1;
	DelayAt24c02(1);
	bat=rSDA;
	SCL=0;
	return bat;
}

/*******************************************************************************************************
** 函数: I2cWriteByte,写一字节数据
**------------------------------------------------------------------------------------------------------
** 参数: b 数据
** 返回: void
********************************************************************************************************/
void I2cWriteByte(unsigned char b)
{	unsigned char i=0;
	for(i=0;i<8;i++)
	{	
		SDA=b&0x80 ? 1:0;
		SCL=1; 
		DelayAt24c02(1);
		SCL=0;
		b<<=1;
	}
}

/*******************************************************************************************************
** 函数: I2cReadByte,读取一字节
**------------------------------------------------------------------------------------------------------
** 参数: dat 数据指针
** 返回: void
********************************************************************************************************/
void I2cReadByte(unsigned char *dat)
{	unsigned char i;
	for(i=0;i<8;i++)
	{	
		*dat<<=1; 
		SCL=1;
		DelayAt24c02(1);
		*dat|=rSDA;
		SCL=0;
	}
}

/********************************************************************************************************
**                            End Of File
********************************************************************************************************/
